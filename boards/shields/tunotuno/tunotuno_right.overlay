// tunotuno right half: charlieplex
//   gpios index 0..5 = D1..D6 (schematic nets pin1..pin6)
//   interrupt        = D0 (schematic net IRQ)
//   D7..D10 are reserved for the trackball (J1).

#include "tunotuno.dtsi"

&default_transform {
    col-offset = <0>;
};

&kscan {
    interrupt-gpios = <&xiao_d 0 (GPIO_ACTIVE_HIGH | GPIO_PULL_DOWN)>;
    gpios
        = <&xiao_d 1 GPIO_ACTIVE_HIGH>
        , <&xiao_d 2 GPIO_ACTIVE_HIGH>
        , <&xiao_d 3 GPIO_ACTIVE_HIGH>
        , <&xiao_d 4 GPIO_ACTIVE_HIGH>
        , <&xiao_d 5 GPIO_ACTIVE_HIGH>
        , <&xiao_d 6 GPIO_ACTIVE_HIGH>
        ;
};
