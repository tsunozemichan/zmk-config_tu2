## boards/shields/tunotuno/Kconfig.defconfig
```kconfig
if SHIELD_TUNOTUNO_LEFT

config ZMK_KEYBOARD_NAME
    default "tunotuno"

config ZMK_SPLIT_ROLE_CENTRAL
    default y

endif # SHIELD_TUNOTUNO_LEFT

if SHIELD_TUNOTUNO_LEFT || SHIELD_TUNOTUNO_RIGHT

config ZMK_SPLIT
    default y

config ZMK_USB_LOGGING
    default y

config ZMK_LOG_LEVEL_WRN
    default y

endif # SHIELD_TUNOTUNO_LEFT || SHIELD_TUNOTUNO_RIGHT
```

## boards/shields/tunotuno/Kconfig.shield
```kconfig
config SHIELD_TUNOTUNO_LEFT
    def_bool $(shields_list_contains,tunotuno_left)

config SHIELD_TUNOTUNO_RIGHT
    def_bool $(shields_list_contains,tunotuno_right)
```
